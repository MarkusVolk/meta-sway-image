## conf/layer.conf
```bitbake
# We have a conf and classes directory, add to BBPATH
BBPATH .= ":${LAYERDIR}"

# We have recipes-* directories, add to BBFILES
BBFILES += "${LAYERDIR}/recipes-*/*/*.bb ${LAYERDIR}/recipes-*/*/*.bbappend"

BBFILE_COLLECTIONS += "sway-image"
BBFILE_PATTERN_sway-image = "^${LAYERDIR}/"
BBFILE_PRIORITY_sway-image = "7"

# This should only be incremented on significant changes that will
# cause compatibility issues with other layers
LAYERVERSION_sway-image = "1"
LAYERSERIES_COMPAT_sway-image = "mickledore"
LAYERDEPENDS_sway-image = "core"
```
